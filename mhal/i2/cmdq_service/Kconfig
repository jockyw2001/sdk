## mhal/i2/rgn/drv/cover/Kconfig
```kconfig
config MS_COVER
	tristate "COVER driver"
	default n
	help

config MS_COVER_INFINITY2
    tristate "Cover driver support for iNfinity2"
    depends on MS_COVER
    depends on ARCH_INFINITY2
```

## mhal/i2/rgn/drv/gop/Kconfig
```kconfig
config MS_GOP
	tristate "GOP driver"
	default n
	help

config MS_GOP_INFINITY2
    tristate "GOP driver support for iNfinity2"
    depends on MS_GOP
    depends on ARCH_INFINITY2
```

## mhal/i2/utpa/modules/audio/api/audio/Kconfig
```kconfig
config API_AUDIO

tristate "AUDIO"
default n

---help---
Enable compilation option for API AUDIO

config AUDIO_UTOPIA_20_ENABLE
        bool "Enable AUDIO 20"
        default y
        help
          Select if you want to enable AUDIO Utopia 2_0. If unsure, say 'Y'.
```

## mhal/i2/utpa/modules/dmx/drv/cilink/Kconfig
```kconfig
config DRV_CILINK

tristate "CILINK"
default n

---help---
Enable compilation option for driver CILINK
```

## mhal/i2/utpa/modules/dscmb/drv/akl/Kconfig
```kconfig
config DRV_AKL

tristate "AKL"
default n

---help---
Enable compilation option for driver AKL

if DRV_AKL
config AKL_UTOPIA_20_ENABLE
	bool "Enable AKL 20"
	default y
	help
	  Select if you want to enable AKL Utopia 2_0. If unsure say 'Y'.

config AKL_NO_PRINTF_ENABLE
	bool "Enable No Print Message"
	default n
	help
	  Select if you want to remove printf message. If unsure, say 'N'.
endif
```

## mhal/i2/utpa/modules/sc/drv/sc/Kconfig
```kconfig
config DRV_SC

tristate "SC"
default n

---help---
Enable compilation option for driver SC

if [ DRV_SC = "y" ]
config SC_UTOPIA_20_ENABLE
        bool "Enable SC 20"
        default n
        help
          Select if you want to enable SC Utopia 2_0. If unsure, say 'Y'.
endif

if [ DRV_SC = "m" ]
config SC_UTOPIA_20_ENABLE
        bool "Enable SC 20"
        default y
        help
          Select if you want to enable SC Utopia 2_0. If unsure, say 'Y'.
endif
```

## mhal/i2/utpa/modules/sys/drv/sys/Kconfig
```kconfig
config DRV_SYS

tristate "SYS"
default n

config OPTEE_2_4
bool "SYS TEEC API use OPTEE Interface 2.4.0, if not define use 1.0.1"
default n

---help---
Enable compilation option for driver SYS
```

## mhal/i2/vpe/drv/scl/Kconfig
```kconfig
config MS_SCL
	tristate "SCL driver"
	help
	To enable MSTAR SCL driver.

config MS_SCL_INFINITY
  tristate "support I1 driver"
	depends on MS_SCL
	depends on ARCH_INFINITY

config MS_SCL_INFINITY2
  tristate "support I2 driver"
	depends on MS_SCL
	depends on ARCH_INFINITY2

config MS_SCL_USBCAM
  tristate "support usbcam"
	depends on MS_SCL

config MS_SCL_INFINITY3
  tristate "support I3 driver"
	depends on MS_SCL
	depends on ARCH_INFINITY3

config MS_SCL_CLEVELAND
  bool "support C4P driver"
	depends on MS_SCL
	depends on ARCH_CLEVELAND
```
